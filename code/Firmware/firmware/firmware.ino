//#include <SPI.h>
#include <Wire.h>
#include <Adafruit_GFX.h>
#include <Adafruit_SSD1306.h>
#include <ezButton.h>
#include <VescUart.h>
#include <SimpleKalmanFilter.h>
#include <ESP32Time.h>

// Variablen für Display Berechnungen:
#define RXD2 16
#define TXD2 17

#define SCREEN_WIDTH 128 // OLED display width, in pixels
#define SCREEN_HEIGHT 32 // OLED display height, in pixels

#define TCAADDR 0x70

#define TACHOMETERADDR 1
#define DISPLAYADDR 2
#define BASICADDR 3
#define POWERMETERADDR 4

#define REKUPERATION 14
#define SENSOR 32
#define LICHT_IN 26
int licht = 0; 
#define BREMSLICHT_IN 27
int bremse = 0;
#define HUPE_IN 25
int hupe = 0;
#define GAS 33

#define LICHT_OUT 0
#define RUECKLICHT_OUT 18
#define BREMSLICHT_OUT 5
#define HUPE_OUT 4

#define SELECT 1
#define VIEW 1
#define OPTION 19
#define OK 19
#define MENU 3


// Variablen: TODO -> Speichern und versuchen zu lesen, ansonsten Standardwert nehmen 

int d = 2; // Dashboardauswahl
int f = 1; // Fahrmodiauswahl
int v = 1; // Loggingmenü (verbose)
int c = 0; // Spaltenauswahl der UI (column)

long lastDebounceTime = 0;
long debounceDelay = 100;

bool logging = false; //
String stick; // Joystickposition oder Button -> Delay beachten
float km = 0; // Tageskm
float odo = 6700; // Gesamtkilometer // Todo -> Read & Write mit Poweroff
float whkm = 15; // in Wh/km
float wh = 200; // Gesamtverbrauch seit Reset

// Vom VESC:
int rpm;
float voltage;
float current;
float motorcurrent;
float tempVesc;
int power;
float amphours;
float wattHours;
float tach;
float distance;
float velocity;
float batpercentage;
float powerfiltered;
float rpmfiltered;


const unsigned char basicUI [] PROGMEM = {
	0x01, 0xc0, 0x00, 0x00, 0x00, 0x00, 0x00, 0x00, 0x00, 0x00, 0x00, 0x00, 0x00, 0x00, 0x00, 0x00, 
	0x02, 0x20, 0x00, 0x00, 0x00, 0x00, 0x00, 0x00, 0x00, 0x00, 0x00, 0x00, 0x00, 0x00, 0xe0, 0x00, 
	0x1f, 0xfc, 0x00, 0x00, 0x00, 0x00, 0x00, 0x00, 0x00, 0x00, 0x00, 0x00, 0x00, 0x01, 0xfc, 0x00, 
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	0x1f, 0xfc, 0x00, 0x00, 0x00, 0x00, 0x00, 0x00, 0x00, 0x00, 0x00, 0x00, 0xc0, 0x00, 0x00, 0x00
};

const unsigned char powermeterUI [] PROGMEM = {
	0x00, 0x00, 0x00, 0x00, 0x00, 0x00, 0x00, 0x00, 0x00, 0x00, 0x00, 0x00, 0x00, 0x00, 0x00, 0x00, 
	0x00, 0x00, 0x00, 0x00, 0x00, 0x00, 0x00, 0x00, 0x00, 0x00, 0x00, 0x00, 0x00, 0x00, 0x00, 0x00, 
	0x80, 0x00, 0x00, 0x00, 0x00, 0x00, 0x00, 0x00, 0x00, 0x00, 0x00, 0x00, 0x00, 0x00, 0x00, 0x00, 
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	0x00, 0x00, 0x00, 0x00, 0x00, 0x00, 0x00, 0x00, 0x00, 0x00, 0x00, 0x00, 0x00, 0x00, 0x00, 0x00
};

const unsigned char tachometerUI [] PROGMEM = {
	0x00, 0x00, 0x00, 0x00, 0x00, 0x00, 0x00, 0x00, 0x00, 0x00, 0x00, 0x00, 0x00, 0x00, 0x00, 0x00, 
	0x00, 0x00, 0x00, 0x00, 0x00, 0x00, 0x00, 0x00, 0x00, 0x00, 0x00, 0x00, 0x00, 0x00, 0x00, 0x00, 
	0x00, 0x00, 0x00, 0x00, 0x00, 0x00, 0x00, 0x00, 0x00, 0x00, 0x00, 0x00, 0x00, 0x00, 0x00, 0x00, 
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	0x00, 0x00, 0x00, 0x00, 0x00, 0x00, 0x00, 0x00, 0x00, 0x00, 0x00, 0x00, 0x00, 0x00, 0x00, 0x00
};

const unsigned char dashboard [] PROGMEM = {
	// 'Dashboard, 128x32px
	0x00, 0x00, 0x00, 0x00, 0x00, 0x00, 0x00, 0x00, 0x00, 0x00, 0x00, 0x00, 0x00, 0x00, 0x00, 0x00, 
	0x00, 0x00, 0x00, 0x00, 0x00, 0x00, 0x00, 0x00, 0x00, 0x00, 0x00, 0x00, 0x00, 0x00, 0x00, 0x00, 
	0x00, 0x00, 0x00, 0x00, 0x00, 0x00, 0x00, 0x00, 0x00, 0x00, 0x00, 0x00, 0x00, 0x00, 0x00, 0x00, 
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	0x3f, 0xff, 0xff, 0xff, 0xff, 0xff, 0xff, 0xff, 0xff, 0xff, 0xff, 0xff, 0xff, 0xff, 0xff, 0xfc
};




Adafruit_SSD1306 display(SCREEN_WIDTH, SCREEN_HEIGHT, &Wire);
Adafruit_SSD1306 basic(SCREEN_WIDTH, SCREEN_HEIGHT, &Wire);
Adafruit_SSD1306 powermeter(SCREEN_WIDTH, SCREEN_HEIGHT, &Wire);
Adafruit_SSD1306 tachometer(SCREEN_WIDTH, SCREEN_HEIGHT, &Wire);

VescUart UART;
SimpleKalmanFilter Filter1(2, 2, 0.01);
ESP32Time rtc(3600);

void setup() {
  // put your setup code here, to run once:
  Serial2.begin(115200, SERIAL_8N1, RXD2, TXD2);
  Serial.begin(115200);

  while (!Serial) {;}

  rtc.setTime(10, 59, 17, 4, 2, 2023); 

  tcaselect(DISPLAYADDR);
  if (!display.begin(SSD1306_SWITCHCAPVCC, 0x3C)) { 
  Serial.println(F("Display allocation failed"));
  for(;;); // Don't proceed, loop forever
  }

  display.setTextSize(2);
  display.setTextColor(WHITE);
  String startuptext = "Elmoto HR-2";
  display.setCursor(20, 16);
  display.print(startuptext);
  display.display();

  tcaselect(BASICADDR);
  if (!basic.begin(SSD1306_SWITCHCAPVCC, 0x3C)) { 
  Serial.println(F("Display allocation failed"));
  for(;;); // Don't proceed, loop forever
  }
  delay(50);
  basic.clearDisplay();
  basic.drawBitmap(0, 0, basicUI, 128, 32, WHITE);
  basic.display();

  tcaselect(POWERMETERADDR);
  if (!powermeter.begin(SSD1306_SWITCHCAPVCC, 0x3C)) { 
  Serial.println(F("Display allocation failed"));
  //for(;;); // Don't proceed, loop forever
  }
  delay(50);
  powermeter.clearDisplay();
  powermeter.drawBitmap(0, 0, powermeterUI, 128, 32, WHITE);
  powermeter.display();

  tcaselect(TACHOMETERADDR); 
  if (!tachometer.begin(SSD1306_SWITCHCAPVCC, 0x3C)) { 
  Serial.println(F("Display allocation failed"));
  for(;;); // Don't proceed, loop forever
  }
  delay(50);
  tachometer.clearDisplay();
  tachometer.drawBitmap(0, 0, tachometerUI, 128, 32, WHITE);
  tachometer.display();

  UART.setSerialPort(&Serial2);


  pinMode(LICHT_IN, INPUT_PULLUP);
  pinMode(BREMSLICHT_IN, INPUT_PULLUP);
  pinMode(HUPE_IN, INPUT_PULLUP);

  pinMode(SELECT, INPUT_PULLUP);
  pinMode(OPTION, INPUT_PULLUP);
  pinMode(MENU, INPUT_PULLUP);

  pinMode(LICHT_OUT, OUTPUT);
  pinMode(BREMSLICHT_OUT, OUTPUT);
  pinMode(HUPE_OUT, OUTPUT);
  

  delay(1000); // Pause for 1 seconds

  // Clear the buffer
  refreshUI();
  

}

void loop() {
  // put your main code here, to run repeatedly:
  delay(100); // this speeds up the simulation
  
  buttons();
  Serial.println("Test0");


  getTelemetry();
  refreshDisplay();

  Serial.println(rpmfiltered);
  Serial.println(voltage);
  Serial.println(current);
  Serial.println(motorcurrent);
  Serial.println(tempVesc);
  Serial.println(power);
  Serial.println(amphours);
  Serial.println(tach);
  Serial.println(batpercentage);

  //refreshUI();


  //Serial.println(stick);
  //Serial.println(change);

  /*
  Serial.print("Spalte: ");
  Serial.print(c);
  Serial.println();
  Serial.print("Dashboard: ");
  Serial.print(d);
  Serial.println();
  Serial.print("Fahrmodus: ");
  Serial.print(f);
  Serial.println();
  Serial.print("Loggingmenü: ");
  Serial.print(v);
  Serial.println();
*/  


}




// Wenn man es für große Menüs realisieren will: Dann wohl am besten mit Arrays. Min und Max werden in bspw. Zeile 0 für entsprechende Spalte hinterlegt
// Bei Hoch / Runter / Links / Rechts wird dann überprüft, ob man an der Grenze ist, ansonsten entsprechend ein Cursor erhöht / verringert








